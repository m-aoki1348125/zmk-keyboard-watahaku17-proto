## boards/shields/watahaku_17/Kconfig.defconfig
```kconfig
if SHIELD_WATAHAKU_17_LEFT || SHIELD_WATAHAKU_17_RIGHT

config ZMK_KEYBOARD_NAME
    default "watahaku17"

config ZMK_SPLIT
    default y

config SPI
    default y

config INPUT
    default y

config ZMK_MOUSE
    default y

config PAW3222
    default y
 
endif
```

## boards/shields/watahaku_17/Kconfig.shield
```kconfig
config SHIELD_WATAHAKU_17_LEFT
    def_bool $(shields_list_contains,watahaku_17_left)

config SHIELD_WATAHAKU_17_RIGHT
    def_bool $(shields_list_contains,watahaku_17_right)
```
